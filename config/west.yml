## config/west.yml
```yaml
manifest:
  remotes:
    - name: zmkfirmware
      url-base: https://github.com/zmkfirmware
    # - name: kumamuk-git
      # url-base: https://github.com/kumamuk-git
    - name: sayu-hub
      url-base: https://github.com/sayu-hub
  projects:
    - name: zmk
      remote: zmkfirmware
      revision: main
      import: app/west.yml
    - name: zmk-pmw3610-driver
      # remote: kumamuk-git
      remote: sayu-hub
      revision: main
  self:
    path: config
```
